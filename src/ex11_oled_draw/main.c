// Code generated by MCHP Chatbot
/*******************************************************************************
  Main Source File

  Company:
    Microchip Technology Inc.

  File Name:
    main.c

  Summary:
    This file contains the "main" function for a project.

  Description:
    This file contains the "main" function for a project.  The
    "main" function calls the "SYS_Initialize" function to initialize the state
    machines of all modules in the system
 *******************************************************************************/

// *****************************************************************************
// *****************************************************************************
// Section: Included Files
// *****************************************************************************
// *****************************************************************************

#include "OLED128x64.h"
#include "definitions.h" // SYS function prototypes, MCC-generated system and peripheral headers
#include <stdbool.h> // Defines true
#include <stddef.h>  // Defines NULL
#include <stdlib.h>  // Defines EXIT_FAILURE

// #include "OLED_FONTs.h"
//  *****************************************************************************
//  *****************************************************************************
//  Section: Global Variables
//  *****************************************************************************
//  *****************************************************************************

volatile bool bIsI2C_DONE = true;
extern const uint8_t BMP3[];
// *****************************************************************************
// *****************************************************************************
// Section: Function Prototypes
// *****************************************************************************
// *****************************************************************************

void I2C_EventHandler(uintptr_t context);

// *****************************************************************************
// *****************************************************************************
// Section: I2C Event Handler
// *****************************************************************************
// *****************************************************************************

void I2C_EventHandler(uintptr_t context) {
  if (SERCOM2_I2C_ErrorGet() == SERCOM_I2C_ERROR_NONE)
    bIsI2C_DONE = true;
}

// *****************************************************************************
// *****************************************************************************
// Section: Main Entry Point
// *****************************************************************************
// *****************************************************************************



int main(void) {
  //extern const uint8_t BMP3[];
  extern const uint8_t BMP_buffer[];
  int i1, i2,i3;
  /* Initialize all modules */
  SYS_Initialize(NULL);

  /* Register the I2C event callback for SERCOM2 */
  SERCOM2_I2C_CallbackRegister(I2C_EventHandler, 0);

  /* Start SYSTICK (100 ms interval by MCC config) */
  SYSTICK_TimerStart();

  /* Wait 200ms for OLED power-up/reset */
  // for (uint32_t i = 0; i < 2; i++)
  // {
  //     while(!SYSTICK_TimerPeriodHasExpired()) {}
  // }

  SYSTICK_DelayMs(200);

  /* Initialize OLED */
  OLED_Init();
  OLED_CLS();

  /* Draw BMP3[] font image to OLED using Draw_BMP */
  // Draw_BMP(BMP3);
  i3=0;
  for (i2 = 0; i2 < 8; i2++) {
    OLED_Set_Pos(0, i2);
    for (i1 = 0; i1 < 128; i1++) {
      if (i1 !=127){
        OLEDWrDat( ~ BMP3[i3]);
      }
      
      i3++;
    }
  }

  /* Main loop (put your application code here) */
  while (1) {
    /* Can add animation, update screen, etc */
  }

  /* Execution should not come here during normal operation */
  return EXIT_FAILURE;
}

/*******************************************************************************
 End of File
*/
